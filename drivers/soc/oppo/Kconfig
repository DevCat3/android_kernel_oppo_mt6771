## drivers/soc/oppo/Kconfig
```kconfig
#ifdef OPLUS_FEATURE_TP_BASIC
config OPPO_ARCH_FILE
    bool "for build directory oppo"
    ---help---
    say Y to buid in
source "drivers/soc/oppo/oppo_devinfo/Kconfig"

#ifdef OPLUS_FEATURE_NFC_CONSOFT
config OPPO_NFC
  bool "config oppo nfc chipset"
  select OPPO_ARCH_FILE
  help
	define this config to get nfc chipset version from dts.
#endif /* OPLUS_FEATURE_NFC_CONSOFT
source "drivers/soc/oppo/oppo_devinfo/Kconfig"

#ifdef OPLUS_FEATURE_NFC_CONSOFT
source "drivers/soc/oppo/oppo_nfc/Kconfig"
#endif /* OPLUS_FEATURE_NFC_CONSOFT */
#ifdef OPLUS_FEATURE_SENSOR_SMEM
source "drivers/soc/oppo/oppo_als_cali_value/Kconfig"
#endif /*OPLUS_FEATURE_SENSOR_SMEM */

#ifdef VENDOR_EDIT
source "drivers/soc/oppo/oppo_wakelock_profiler/Kconfig"
#endif /* VENDOR_EDIT */

#ifdef OPLUS_FEATURE_MEMLEAK_DETECT
source "drivers/soc/oppo/oppo_svelte/Kconfig"
#endif /* OPLUS_FEATURE_MEMLEAK_DETECT */
```
